## boards/shields/split_beginnings/Kconfig.defconfig
```kconfig
if SHIELD_SPLIT_BEGINNINGS_L

config ZMK_KEYBOARD_NAME
    default "splitbeginnings"

config ZMK_SPLIT_ROLE_CENTRAL
    default y

config ZMK_SPLIT_BLE_ROLE_CENTRAL
    default y

endif

if SHIELD_SPLIT_BEGINNINGS_L || SHIELD_SPLIT_BEGINNINGS_R

config ZMK_SPLIT
    default y

endif
```

## boards/shields/split_beginnings/Kconfig.shield
```kconfig
config SHIELD_SPLIT_BEGINNINGS_L
    def_bool $(shields_list_contains, split_beginnings_l)

config SHIELD_SPLIT_BEGINNINGS_R
    def_bool $(shields_list_contains, split_beginnings_r)
```
